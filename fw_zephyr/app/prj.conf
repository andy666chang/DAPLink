## CMakeLists.txt
```
# SPDX-License-Identifier: Apache-2.0

cmake_minimum_required(VERSION 3.20.0)

set(DAPLINK_IMAGE IF)
include(${CMAKE_CURRENT_SOURCE_DIR}/../common/daplink.cmake)

find_package(Zephyr REQUIRED HINTS $ENV{ZEPHYR_BASE})
project(daplink_interface)

daplink_setup()

zephyr_include_directories(
  ${CMAKE_CURRENT_SOURCE_DIR}/include
  ${DAPLINK_DIR}/cmsis-dap
  ${DAPLINK_DIR}/cmsis-driver
)

# CMSIS-DAP core, reused as-is from DAPLink
target_sources(app PRIVATE
  ${DAPLINK_DIR}/cmsis-dap/DAP.c
  ${DAPLINK_DIR}/cmsis-dap/SW_DP.c
)

# Zephyr port
target_sources(app PRIVATE
  src/main.c
  src/dap_gpio.c
  src/dap_usb.c
  src/info.c
  src/led.c
  src/bootloader.c
  src/dap_vendor.c
)
target_sources_ifdef(CONFIG_APP_USB2UART app PRIVATE src/usb2uart.c)
target_sources_ifdef(CONFIG_APP_SWO_UART app PRIVATE
  ${DAPLINK_DIR}/cmsis-dap/SWO.c
  src/swo_uart.c
)
```

## Kconfig
```
# SPDX-License-Identifier: Apache-2.0

mainmenu "DAPLink Zephyr"

config APP_USB2UART
	bool "USB CDC-ACM <-> target UART bridge"
	default y
	select SERIAL
	select UART_INTERRUPT_DRIVEN
	select UART_LINE_CTRL
	select USB_CDC_ACM
	select CDC_ACM_DTE_RATE_CALLBACK_SUPPORT
	help
	  Expose the target UART (zephyr,target-uart chosen node) as a
	  USB virtual COM port, like DAPLink usb2uart.

config APP_USB2UART_BUF_SIZE
	int "USB2UART ring buffer size"
	default 256
	depends on APP_USB2UART

config APP_SWO_UART
	bool "SWO UART capture"
	default y
	help
	  SWO trace capture on the "daplink,swo-uart" chosen USART (RX only),
	  using DAPLink SWO.c with a CMSIS-Driver USART (src/swo_uart.c).

config APP_SWO_BUFFER_SIZE
	int "SWO trace buffer size (must be 2^n)"
	default 4096
	depends on APP_SWO_UART

config APP_DAP_PACKET_COUNT
	int "CMSIS-DAP packet buffer count"
	default 4
	range 1 255

source "Kconfig.zephyr"
```

## prj.conf
```kconfig
# Interface @ 0x0800C000 (if_partition), see standalone.conf
CONFIG_USE_DT_CODE_PARTITION=y

# Driver
CONFIG_GPIO=y
CONFIG_HWINFO=y

# USB device stack (CMSIS-DAP v2 WinUSB + CDC ACM)
CONFIG_USB_DEVICE_STACK=y
CONFIG_USB_DEVICE_BOS=y
CONFIG_USB_COMPOSITE_DEVICE=y
CONFIG_USB_DEVICE_VID=0x0D28
CONFIG_USB_DEVICE_PID=0x0204
CONFIG_USB_DEVICE_MANUFACTURER="ARM"
CONFIG_USB_DEVICE_PRODUCT="DAPLink CMSIS-DAP"
# 96 bit STM32 UID as hex, see info.c
CONFIG_USB_DEVICE_SN="000000000000000000000000"
CONFIG_USB_MAX_POWER=50
CONFIG_USB_DEVICE_INITIALIZE_AT_BOOT=n

# USB2UART
CONFIG_APP_USB2UART=y

# Kernel
CONFIG_MAIN_STACK_SIZE=1024

# Console/log is disabled by default: USART1 pins (PA9/PA10) are
# used as LED / SWO on the DAPLink hardware. See debug.conf.
CONFIG_CONSOLE=n
CONFIG_UART_CONSOLE=n
CONFIG_LOG=n
```

## debug.conf
```kconfig
# Debug overlay: printk/log over RTT (via SWD of the HIC itself)
CONFIG_DEBUG_OPTIMIZATIONS=y
CONFIG_LOG=y
CONFIG_CONSOLE=y
CONFIG_USE_SEGGER_RTT=y
CONFIG_RTT_CONSOLE=y
CONFIG_LOG_BACKEND_RTT=y
# RAM: 19 KB available (cfgram reserved), shrink buffers for RTT/log
CONFIG_SEGGER_RTT_BUFFER_SIZE_UP=512
CONFIG_SEGGER_RTT_BUFFER_SIZE_DOWN=16
CONFIG_LOG_BUFFER_SIZE=512
CONFIG_APP_SWO_BUFFER_SIZE=2048
```

## standalone.conf
```kconfig
# Interface without bootloader, linked @ 0x08000000 (debug / no BL)
CONFIG_USE_DT_CODE_PARTITION=n
CONFIG_FLASH_LOAD_OFFSET=0x0
CONFIG_FLASH_LOAD_SIZE=0x0
```

## app.overlay
```dts
/* Interface @ 0x0800C000, behind the bootloader (DAPLINK_ROM_IF_START) */
/ {
	chosen {
		zephyr,code-partition = &if_partition;
	};
};
```

## src/main.c
```c
/*
 * DAPLink interface firmware, Zephyr port.
 *
 * Board: stm32_min_dev/stm32f103xb/blue (DAPLink HIC: hardware/daplink)
 *
 * Features:
 *   - CMSIS-DAP v2 over WinUSB bulk (DAP.c / SW_DP.c from DAPLink)
 *   - USB CDC-ACM <-> target UART bridge (usb2uart)
 *
 * SPDX-License-Identifier: Apache-2.0
 */

#include <zephyr/kernel.h>
#include <zephyr/usb/usb_device.h>

#include "DAP_config.h"
#include "DAP.h"
#include "info.h"
#include "led.h"
#include "dap_usb.h"
#include "usb2uart.h"

int dap_gpio_init(void);

int main(void)
{
    int ret;

    info_init();

    ret = led_init();
    if (ret) {
        return ret;
    }

    ret = dap_gpio_init();
    if (ret) {
        return ret;
    }

    DAP_Setup();

    ret = dap_usb_init();
    if (ret) {
        return ret;
    }

#if defined(CONFIG_APP_USB2UART)
    ret = usb2uart_init();
    if (ret) {
        return ret;
    }
#endif

    ret = usb_enable(NULL);
    if (ret) {
        return ret;
    }

    /* CMSIS-DAP command loop (DAPLink: main_task / hid & bulk events) */
    while (1) {
        dap_usb_process();
    }

    return 0;
}
```

## include/DAP_config.h
```c
/*
 * CMSIS-DAP hardware configuration for the Zephyr port.
 *
 * Ported from DAPLink source/hic_hal/stm32/stm32f103xb/DAP_config.h
 * HAL macros are replaced by Zephyr devicetree / Kconfig, the SWD pin
 * access stays on raw GPIO registers for speed.
 *
 * SPDX-License-Identifier: Apache-2.0
 */

#ifndef __DAP_CONFIG_H__
#define __DAP_CONFIG_H__

#include <stdint.h>
#include <zephyr/kernel.h>
#include "IO_Config.h"

#define CPU_CLOCK               CONFIG_SYS_CLOCK_HW_CYCLES_PER_SEC ///< Specifies the CPU Clock in Hz

#define IO_PORT_WRITE_CYCLES    2U              ///< I/O Cycles: 2=default, 1=Cortex-M0+ fast I/0

#define DAP_SWD                 1               ///< SWD Mode:  1 = available, 0 = not available

#define DAP_JTAG                0               ///< JTAG Mode: 1 = available, 0 = not available.

#define DAP_JTAG_DEV_CNT        0               ///< Maximum number of JTAG devices on scan chain

#define DAP_DEFAULT_PORT        1               ///< Default JTAG/SWJ Port Mode: 1 = SWD, 2 = JTAG.

#define DAP_DEFAULT_SWJ_CLOCK   5000000         ///< Default SWD/JTAG clock frequency in Hz.

/// Full-speed WinUSB bulk endpoint
#define DAP_PACKET_SIZE         64              ///< Specifies Packet Size in bytes.

#define DAP_PACKET_COUNT        CONFIG_APP_DAP_PACKET_COUNT ///< Buffers: 64 = Full-Speed, 4 = High-Speed.

#if defined(CONFIG_APP_SWO_UART)
#define SWO_UART                1               ///< SWO UART:  1 = available, 0 = not available
#else
#define SWO_UART                0               ///< SWO UART:  1 = available, 0 = not available
#endif

#define SWO_UART_DRIVER         1               ///< USART Driver instance number (Driver_USART#).

#define SWO_UART_MAX_BAUDRATE   4500000U        ///< SWO UART Maximum Baudrate in Hz (PCLK2 / 16)

#define SWO_MANCHESTER          0               ///< SWO Manchester:  1 = available, 0 = not available.

#define SWO_BUFFER_SIZE         COND_CODE_1(CONFIG_APP_SWO_UART, (CONFIG_APP_SWO_BUFFER_SIZE), (4096U)) ///< SWO Trace Buffer Size in bytes (must be 2^n).

#define SWO_STREAM              0               ///< SWO Streaming Trace: 1 = available, 0 = not available.

#define TIMESTAMP_CLOCK         1000000U        ///< Timestamp clock in Hz (0 = timestamps not supported).

#define DAP_UART                0               ///< DAP UART:  1 = available, 0 = not available.

#define DAP_UART_USB_COM_PORT   0               ///< USB COM Port:  1 = available, 0 = not available.

#define TARGET_FIXED            0               ///< Target: 1 = known, 0 = unknown;


/* STM32F1 CRL/CRH 4-bit pin config: MODE[1:0] CNF[1:0] */
#define PIN_CFG_OUT_PP          0x3U            ///< Output push-pull, 50MHz
#define PIN_CFG_OUT_OD          0x7U            ///< Output open-drain, 50MHz
#define PIN_CFG_IN_PULL         0x8U            ///< Input pull-up/down
#define PIN_CFG_IN_ANALOG       0x0U            ///< Analog (high-Z)

__STATIC_FORCEINLINE void pin_cfg(GPIO_TypeDef *GPIOx, uint8_t pin_bit, uint32_t cfg)
{
    volatile uint32_t *cr = (pin_bit >= 8) ? &GPIOx->CRH : &GPIOx->CRL;
    uint32_t shift = (pin_bit & 7U) << 2;

    *cr = (*cr & ~(0xFU << shift)) | (cfg << shift);
}

__STATIC_FORCEINLINE void pin_out_init(GPIO_TypeDef *GPIOx, uint8_t pin_bit)
{
    pin_cfg(GPIOx, pin_bit, PIN_CFG_OUT_PP);
}

__STATIC_FORCEINLINE void pin_out_od_init(GPIO_TypeDef *GPIOx, uint8_t pin_bit)
{
    pin_cfg(GPIOx, pin_bit, PIN_CFG_OUT_OD);
}

/* mode: 0 = high-Z, 1 = pull-up, 2 = pull-down */
__STATIC_FORCEINLINE void pin_in_init(GPIO_TypeDef *GPIOx, uint8_t pin_bit, uint8_t mode)
{
    pin_cfg(GPIOx, pin_bit, mode ? PIN_CFG_IN_PULL : PIN_CFG_IN_ANALOG);
    if (mode == 1) {
        GPIOx->BSRR = (1U << pin_bit);
    } else if (mode == 2) {
        GPIOx->BRR = (1U << pin_bit);
    }
}

// Configure DAP I/O pins ------------------------------

__STATIC_INLINE void PORT_JTAG_SETUP(void)
{
}

__STATIC_INLINE void PORT_SWD_SETUP(void)
{
    // Set SWCLK HIGH
    pin_out_init(SWCLK_TCK_PIN_PORT, SWCLK_TCK_PIN_Bit);
    SWCLK_TCK_PIN_PORT->BSRR = SWCLK_TCK_PIN;
    // Set SWDIO HIGH
    pin_out_init(SWDIO_OUT_PIN_PORT, SWDIO_OUT_PIN_Bit);
    SWDIO_OUT_PIN_PORT->BSRR = SWDIO_OUT_PIN;

    pin_in_init(SWDIO_IN_PIN_PORT, SWDIO_IN_PIN_Bit, 1);
    // Set RESET HIGH
    pin_out_od_init(nRESET_PIN_PORT, nRESET_PIN_Bit);
    nRESET_PIN_PORT->BSRR = nRESET_PIN;
}

__STATIC_INLINE void PORT_OFF(void)
{
    pin_in_init(SWCLK_TCK_PIN_PORT, SWCLK_TCK_PIN_Bit, 0);
    pin_in_init(SWDIO_OUT_PIN_PORT, SWDIO_OUT_PIN_Bit, 0);
    pin_in_init(SWDIO_IN_PIN_PORT, SWDIO_IN_PIN_Bit, 0);
}

// SWCLK/TCK I/O pin -------------------------------------

__STATIC_FORCEINLINE uint32_t PIN_SWCLK_TCK_IN(void)
{
    return ((SWCLK_TCK_PIN_PORT->ODR & SWCLK_TCK_PIN) ? 1 : 0);
}

__STATIC_FORCEINLINE void PIN_SWCLK_TCK_SET(void)
{
    SWCLK_TCK_PIN_PORT->BSRR = SWCLK_TCK_PIN;
}

__STATIC_FORCEINLINE void PIN_SWCLK_TCK_CLR(void)
{
    SWCLK_TCK_PIN_PORT->BRR = SWCLK_TCK_PIN;
}

// SWDIO/TMS Pin I/O --------------------------------------

__STATIC_FORCEINLINE uint32_t PIN_SWDIO_TMS_IN(void)
{
    return ((SWDIO_IN_PIN_PORT->IDR & SWDIO_IN_PIN) ? 1 : 0);
}

__STATIC_FORCEINLINE void PIN_SWDIO_TMS_SET(void)
{
    SWDIO_OUT_PIN_PORT->BSRR = SWDIO_OUT_PIN;
}

__STATIC_FORCEINLINE void PIN_SWDIO_TMS_CLR(void)
{
    SWDIO_OUT_PIN_PORT->BRR = SWDIO_OUT_PIN;
}

__STATIC_FORCEINLINE uint32_t PIN_SWDIO_IN(void)
{
    return ((SWDIO_IN_PIN_PORT->IDR & SWDIO_IN_PIN) ? 1 : 0);
}

__STATIC_FORCEINLINE void PIN_SWDIO_OUT(uint32_t bit)
{
    if (bit & 1) {
        SWDIO_OUT_PIN_PORT->BSRR = SWDIO_OUT_PIN;
    } else {
        SWDIO_OUT_PIN_PORT->BRR = SWDIO_OUT_PIN;
    }
}

__STATIC_FORCEINLINE void PIN_SWDIO_OUT_ENABLE(void)
{
    pin_out_init(SWDIO_OUT_PIN_PORT, SWDIO_OUT_PIN_Bit);
    SWDIO_OUT_PIN_PORT->BRR = SWDIO_OUT_PIN;
}

__STATIC_FORCEINLINE void PIN_SWDIO_OUT_DISABLE(void)
{
    pin_in_init(SWDIO_OUT_PIN_PORT, SWDIO_OUT_PIN_Bit, 0);
    SWDIO_OUT_PIN_PORT->BSRR = SWDIO_OUT_PIN;
}

// TDI / TDO / nTRST: not available ------------------------

__STATIC_FORCEINLINE uint32_t PIN_TDI_IN(void)
{
    return (0);
}

__STATIC_FORCEINLINE void PIN_TDI_OUT(uint32_t bit)
{
    (void)bit;
}

__STATIC_FORCEINLINE uint32_t PIN_TDO_IN(void)
{
    return (0);
}

__STATIC_FORCEINLINE uint32_t PIN_nTRST_IN(void)
{
    return (0);
}

__STATIC_FORCEINLINE void PIN_nTRST_OUT(uint32_t bit)
{
    (void)bit;
}

// nRESET Pin I/O------------------------------------------

__STATIC_FORCEINLINE uint32_t PIN_nRESET_IN(void)
{
    return ((nRESET_PIN_PORT->IDR >> nRESET_PIN_Bit) & 1);
}

__STATIC_FORCEINLINE void PIN_nRESET_OUT(uint32_t bit)
{
    if (bit & 1) {
        nRESET_PIN_PORT->BSRR = nRESET_PIN;
    } else {
        nRESET_PIN_PORT->BRR = nRESET_PIN;
    }
}

// LEDs (implemented in led.c with Zephyr GPIO API) --------

void LED_CONNECTED_OUT(uint32_t bit);
void LED_RUNNING_OUT(uint32_t bit);

// Timestamp ---------------------------------------------

__STATIC_INLINE uint32_t TIMESTAMP_GET(void)
{
    return (DWT->CYCCNT) / (CPU_CLOCK / TIMESTAMP_CLOCK);
}

// Initialization ----------------------------------------

/* Implemented in dap_gpio.c */
void DAP_SETUP(void);

__STATIC_INLINE uint32_t RESET_TARGET(void)
{
    return (0);              // change to '1' when a device reset sequence is implemented
}

#endif /* __DAP_CONFIG_H__ */
```

## include/IO_Config.h
```c
/*
 * DAPLink IO configuration for the Zephyr port.
 *
 * Pin assignment comes from the devicetree "zephyr,user" node
 * (see boards/ overlay); register access is done directly on the
 * STM32F1 GPIO block for SWD bit-bang speed, as in DAPLink.
 *
 * SPDX-License-Identifier: Apache-2.0
 */

#ifndef __IO_CONFIG_H__
#define __IO_CONFIG_H__

#include <zephyr/devicetree.h>
#include <soc.h>

#define DAP_USER_NODE                DT_PATH(zephyr_user)

#define DAP_GPIO_PORT(prop)          ((GPIO_TypeDef *)DT_REG_ADDR(DT_GPIO_CTLR(DAP_USER_NODE, prop)))
#define DAP_GPIO_BIT(prop)           DT_GPIO_PIN(DAP_USER_NODE, prop)

//SWD
#define SWCLK_TCK_PIN_PORT           DAP_GPIO_PORT(swclk_gpios)
#define SWCLK_TCK_PIN_Bit            DAP_GPIO_BIT(swclk_gpios)
#define SWCLK_TCK_PIN                (1U << SWCLK_TCK_PIN_Bit)

#define SWDIO_OUT_PIN_PORT           DAP_GPIO_PORT(swdio_out_gpios)
#define SWDIO_OUT_PIN_Bit            DAP_GPIO_BIT(swdio_out_gpios)
#define SWDIO_OUT_PIN                (1U << SWDIO_OUT_PIN_Bit)

#define SWDIO_IN_PIN_PORT            DAP_GPIO_PORT(swdio_in_gpios)
#define SWDIO_IN_PIN_Bit             DAP_GPIO_BIT(swdio_in_gpios)
#define SWDIO_IN_PIN                 (1U << SWDIO_IN_PIN_Bit)

// nRESET OUT Pin
#define nRESET_PIN_PORT              DAP_GPIO_PORT(nreset_gpios)
#define nRESET_PIN_Bit               DAP_GPIO_BIT(nreset_gpios)
#define nRESET_PIN                   (1U << nRESET_PIN_Bit)

#endif
```

## include/info.h
```c
/*
 * Subset of DAPLink info.h needed by the CMSIS-DAP core.
 *
 * SPDX-License-Identifier: Apache-2.0
 */

#ifndef INFO_H
#define INFO_H

#ifdef __cplusplus
extern "C" {
#endif

void info_init(void);
const char *info_get_unique_id(void);
const char *info_get_version(void);

#ifdef __cplusplus
}
#endif

#endif
```

## include/osObjects.h
```c
/*
 * Empty osObjects.h for DAPLink SWO.c (only needed with SWO_STREAM).
 *
 * SPDX-License-Identifier: Apache-2.0
 */

#ifndef OS_OBJECTS_H
#define OS_OBJECTS_H

#endif
```

## include/target_board.h
```c
/*
 * Minimal DAPLink target_board.h for the Zephyr port.
 *
 * The upstream dap_strings.h reads target/board strings from g_board_info.
 * The Zephyr port has no target database, so only the fields used by the
 * CMSIS-DAP core are kept.
 *
 * SPDX-License-Identifier: Apache-2.0
 */

#ifndef TARGET_BOARD_H
#define TARGET_BOARD_H

typedef struct target_cfg {
    char *target_vendor;
    char *target_part_number;
} target_cfg_t;

typedef struct board_info {
    const target_cfg_t *target_cfg;
    char *board_vendor;
    char *board_name;
} board_info_t;

extern const board_info_t g_board_info;

#endif
```

## include/util.h
```c
/*
 * Minimal DAPLink util.h for the Zephyr port.
 *
 * SPDX-License-Identifier: Apache-2.0
 */

#ifndef UTIL_H
#define UTIL_H

#include <string.h>
#include <zephyr/sys/util.h>

#endif
```

## src/bootloader.c
```c
/*
 * Interface -> bootloader handover.
 *
 * DAPLink interface sets config_ram.hold_in_bl (settings.c) and resets;
 * the bootloader then stays in MAINTENANCE mode. This writes the same
 * packed record into the shared "cfgram" region (0x20004F00), read by
 * common/daplink/settings/settings.c in the bootloader.
 *
 * SPDX-License-Identifier: Apache-2.0
 */

#include <stdint.h>
#include <string.h>
#include <zephyr/kernel.h>
#include <zephyr/sys/reboot.h>

#include "bootloader.h"

/* 'kvld' in hex - key valid, DAPLink settings.c CFG_KEY */
#define CFG_KEY             0x6b766c64
#define ALLOWED_HEXDUMP     16

/* Mirror of DAPLink settings.c cfg_ram_t, layout must not change */
typedef struct __attribute__((__packed__)) cfg_ram {
    uint32_t key;
    uint16_t size;
    uint8_t hold_in_bl;
    char assert_file_name[64 + 1];
    uint16_t assert_line;
    uint8_t assert_source;
    uint8_t  valid_dumps;
    uint32_t hexdump[ALLOWED_HEXDUMP];
    uint8_t disable_msd;
    uint8_t page_erase_enable;
} cfg_ram_t;

static cfg_ram_t config_ram __attribute__((section("cfgram")));

void bootloader_enter(void)
{
    if (config_ram.key != CFG_KEY) {
        memset(&config_ram, 0, sizeof(config_ram));
        config_ram.key = CFG_KEY;
        config_ram.size = sizeof(config_ram);
    }
    config_ram.hold_in_bl = 1;

    sys_reboot(SYS_REBOOT_COLD);
}
```

## src/bootloader.h
```c
/*
 * Interface -> bootloader handover.
 *
 * SPDX-License-Identifier: Apache-2.0
 */

#ifndef BOOTLOADER_H
#define BOOTLOADER_H

/* Reset into the bootloader MAINTENANCE drive, does not return */
void bootloader_enter(void);

#endif
```

## src/dap_gpio.c
```c
/*
 * DAP I/O initialization (DAP_SETUP) for the Zephyr port.
 *
 * Ported from hic_hal/stm32/stm32f103xb DAP_config.h / gpio.c: pins are
 * claimed once through the Zephyr GPIO API (clock enable + mode), the
 * CMSIS-DAP core then drives them through raw registers.
 *
 * SPDX-License-Identifier: Apache-2.0
 */

#include <zephyr/kernel.h>
#include <zephyr/drivers/gpio.h>

#include "DAP_config.h"

static const struct gpio_dt_spec swclk = GPIO_DT_SPEC_GET(DAP_USER_NODE, swclk_gpios);
static const struct gpio_dt_spec swdio_out = GPIO_DT_SPEC_GET(DAP_USER_NODE, swdio_out_gpios);
static const struct gpio_dt_spec swdio_in = GPIO_DT_SPEC_GET(DAP_USER_NODE, swdio_in_gpios);
static const struct gpio_dt_spec nreset = GPIO_DT_SPEC_GET(DAP_USER_NODE, nreset_gpios);

int dap_gpio_init(void)
{
    int ret;

    if (!gpio_is_ready_dt(&swclk) || !gpio_is_ready_dt(&swdio_out) ||
        !gpio_is_ready_dt(&swdio_in) || !gpio_is_ready_dt(&nreset)) {
        return -ENODEV;
    }

    /* Enables the GPIO port clocks and sets the default pin state */
    ret = gpio_pin_configure_dt(&swclk, GPIO_OUTPUT_HIGH);
    ret |= gpio_pin_configure_dt(&swdio_out, GPIO_OUTPUT_HIGH);
    ret |= gpio_pin_configure_dt(&swdio_in, GPIO_INPUT);
    /* reset configured as open drain output with a pullup */
    ret |= gpio_pin_configure_dt(&nreset, GPIO_OUTPUT_HIGH);

    /* Cycle counter used by TIMESTAMP_GET() */
    CoreDebug->DEMCR |= CoreDebug_DEMCR_TRCENA_Msk;
    DWT->CYCCNT = 0;
    DWT->CTRL |= DWT_CTRL_CYCCNTENA_Msk;

    return ret ? -EIO : 0;
}

void DAP_SETUP(void)
{
    pin_out_init(SWCLK_TCK_PIN_PORT, SWCLK_TCK_PIN_Bit);
    SWCLK_TCK_PIN_PORT->BSRR = SWCLK_TCK_PIN;

    pin_out_init(SWDIO_OUT_PIN_PORT, SWDIO_OUT_PIN_Bit);
    SWDIO_OUT_PIN_PORT->BSRR = SWDIO_OUT_PIN;

    pin_in_init(SWDIO_IN_PIN_PORT, SWDIO_IN_PIN_Bit, 1);

    pin_out_od_init(nRESET_PIN_PORT, nRESET_PIN_Bit);
    nRESET_PIN_PORT->BSRR = nRESET_PIN;

    LED_CONNECTED_OUT(0);
}
```

## src/dap_usb.c
```c
/*
 * CMSIS-DAP v2 (WinUSB bulk) USB interface.
 *
 * Replaces DAPLink usb/bulk/usbd_bulk.c + DAP_queue.c on top of the
 * Zephyr USB device stack. Requests are received in the USB callback and
 * executed by the DAP thread (DAPLink runs them from the USB ISR).
 *
 * SPDX-License-Identifier: Apache-2.0
 */

#include <zephyr/kernel.h>
#include <zephyr/sys/byteorder.h>
#include <zephyr/sys/atomic.h>
#include <zephyr/usb/usb_device.h>
#include <zephyr/usb/bos.h>
#include <zephyr/usb/msos_desc.h>

#include <usb_descriptor.h>

#include "DAP_config.h"
#include "DAP.h"
#include "dap_usb.h"
#include "led.h"

#define DAP_IFACE_STR_DESC      "CMSIS-DAP v2"

#define DAP_USB_EP_OUT          0x01
#define DAP_USB_EP_IN           0x81
#define DAP_USB_EP_OUT_IDX      0
#define DAP_USB_EP_IN_IDX       1

#define WINUSB_VENDOR_CODE      0x20

struct dap_request {
    uint16_t len;
    uint8_t data[DAP_PACKET_SIZE];
};

K_MSGQ_DEFINE(dap_rx_queue, sizeof(struct dap_request), DAP_PACKET_COUNT, 4);

static uint8_t rx_buf[DAP_PACKET_SIZE];
static uint8_t tx_buf[DAP_PACKET_SIZE];
static atomic_t rx_stalled;

struct dap_iface_descriptor {
    uint8_t bLength;
    uint8_t bDescriptorType;
    uint8_t bString[USB_BSTRING_LENGTH(DAP_IFACE_STR_DESC)];
} __packed;

USBD_STRING_DESCR_USER_DEFINE(primary) struct dap_iface_descriptor dap_iface_desc = {
    .bLength = USB_STRING_DESCRIPTOR_LENGTH(DAP_IFACE_STR_DESC),
    .bDescriptorType = USB_DESC_STRING,
    .bString = DAP_IFACE_STR_DESC
};

/* {CDB3B5AD-293B-4663-AA36-1AAE46463776} */
#define CMSIS_DAP_V2_DEVICE_INTERFACE_GUID \
    '{', 0x00, 'C', 0x00, 'D', 0x00, 'B', 0x00, '3', 0x00, 'B', 0x00, \
    '5', 0x00, 'A', 0x00, 'D', 0x00, '-', 0x00, '2', 0x00, '9', 0x00, \
    '3', 0x00, 'B', 0x00, '-', 0x00, '4', 0x00, '6', 0x00, '6', 0x00, \
    '3', 0x00, '-', 0x00, 'A', 0x00, 'A', 0x00, '3', 0x00, '6', 0x00, \
    '-', 0x00, '1', 0x00, 'A', 0x00, 'A', 0x00, 'E', 0x00, '4', 0x00, \
    '6', 0x00, '4', 0x00, '6', 0x00, '3', 0x00, '7', 0x00, '7', 0x00, \
    '6', 0x00, '}', 0x00, 0x00, 0x00, 0x00, 0x00

#define COMPATIBLE_ID_WINUSB \
    'W', 'I', 'N', 'U', 'S', 'B', 0x00, 0x00

static struct msosv2_descriptor {
    struct msosv2_descriptor_set_header header;
#if defined(CONFIG_USB_COMPOSITE_DEVICE)
    struct msosv2_function_subset_header subset_header;
#endif
    struct msosv2_compatible_id compatible_id;
    struct msosv2_guids_property guids_property;
} __packed msosv2_cmsis_dap_desc = {
    /* Tell Windows to bind WinUSB to the CMSIS-DAP v2 interface */
    .header = {
        .wLength = sizeof(struct msosv2_descriptor_set_header),
        .wDescriptorType = MS_OS_20_SET_HEADER_DESCRIPTOR,
        .dwWindowsVersion = 0x06030000,
        .wTotalLength = sizeof(struct msosv2_descriptor),
    },
#if defined(CONFIG_USB_COMPOSITE_DEVICE)
    .subset_header = {
        .wLength = sizeof(struct msosv2_function_subset_header),
        .wDescriptorType = MS_OS_20_SUBSET_HEADER_FUNCTION,
        .wSubsetLength = sizeof(struct msosv2_function_subset_header)
            + sizeof(struct msosv2_compatible_id)
            + sizeof(struct msosv2_guids_property),
    },
#endif
    .compatible_id = {
        .wLength = sizeof(struct msosv2_compatible_id),
        .wDescriptorType = MS_OS_20_FEATURE_COMPATIBLE_ID,
        .CompatibleID = {COMPATIBLE_ID_WINUSB},
    },
    .guids_property = {
        .wLength = sizeof(struct msosv2_guids_property),
        .wDescriptorType = MS_OS_20_FEATURE_REG_PROPERTY,
        .wPropertyDataType = MS_OS_20_PROPERTY_DATA_REG_MULTI_SZ,
        .wPropertyNameLength = 42,
        .PropertyName = {DEVICE_INTERFACE_GUIDS_PROPERTY_NAME},
        .wPropertyDataLength = 80,
        .bPropertyData = {CMSIS_DAP_V2_DEVICE_INTERFACE_GUID},
    },
};

USB_DEVICE_BOS_DESC_DEFINE_CAP struct usb_bos_msosv2_desc {
    struct usb_bos_platform_descriptor platform;
    struct usb_bos_capability_msos cap;
} __packed bos_cap_msosv2 = {
    /* Microsoft OS 2.0 Platform Capability Descriptor */
    .platform = {
        .bLength = sizeof(struct usb_bos_platform_descriptor)
            + sizeof(struct usb_bos_capability_msos),
        .bDescriptorType = USB_DESC_DEVICE_CAPABILITY,
        .bDevCapabilityType = USB_BOS_CAPABILITY_PLATFORM,
        .bReserved = 0,
        /* MS OS 2.0 Platform Capability ID D8DD60DF-4589-4CC7-9CD2-659D9E648A9F */
        .PlatformCapabilityUUID = {
            0xDF, 0x60, 0xDD, 0xD8,
            0x89, 0x45,
            0xC7, 0x4C,
            0x9C, 0xD2,
            0x65, 0x9D, 0x9E, 0x64, 0x8A, 0x9F,
        },
    },
    .cap = {
        .dwWindowsVersion = sys_cpu_to_le32(0x06030000),
        .wMSOSDescriptorSetTotalLength = sys_cpu_to_le16(sizeof(msosv2_cmsis_dap_desc)),
        .bMS_VendorCode = WINUSB_VENDOR_CODE,
        .bAltEnumCode = 0x00
    },
};

static int msosv2_vendor_handle_req(struct usb_setup_packet *setup,
                                    int32_t *len, uint8_t **data)
{
    if (usb_reqtype_is_to_device(setup)) {
        return -ENOTSUP;
    }

    if (setup->bRequest == WINUSB_VENDOR_CODE &&
        setup->wIndex == MS_OS_20_DESCRIPTOR_INDEX) {
        *data = (uint8_t *)(&msosv2_cmsis_dap_desc);
        *len = sizeof(msosv2_cmsis_dap_desc);
        return 0;
    }

    return -ENOTSUP;
}

USBD_CLASS_DESCR_DEFINE(primary, 1) struct {
    struct usb_if_descriptor if0;
    struct usb_ep_descriptor if0_out_ep;
    struct usb_ep_descriptor if0_in_ep;
} __packed dapusb_desc = {
    .if0 = {
        .bLength = sizeof(struct usb_if_descriptor),
        .bDescriptorType = USB_DESC_INTERFACE,
        .bInterfaceNumber = 0,
        .bAlternateSetting = 0,
        .bNumEndpoints = 2,
        .bInterfaceClass = USB_BCC_VENDOR,
        .bInterfaceSubClass = 0,
        .bInterfaceProtocol = 0,
        .iInterface = 0,
    },
    .if0_out_ep = {
        .bLength = sizeof(struct usb_ep_descriptor),
        .bDescriptorType = USB_DESC_ENDPOINT,
        .bEndpointAddress = DAP_USB_EP_OUT,
        .bmAttributes = USB_DC_EP_BULK,
        .wMaxPacketSize = sys_cpu_to_le16(DAP_PACKET_SIZE),
        .bInterval = 0,
    },
    .if0_in_ep = {
        .bLength = sizeof(struct usb_ep_descriptor),
        .bDescriptorType = USB_DESC_ENDPOINT,
        .bEndpointAddress = DAP_USB_EP_IN,
        .bmAttributes = USB_DC_EP_BULK,
        .wMaxPacketSize = sys_cpu_to_le16(DAP_PACKET_SIZE),
        .bInterval = 0,
    },
};

static struct usb_ep_cfg_data dapusb_ep_data[] = {
    [DAP_USB_EP_OUT_IDX] = {
        .ep_cb = usb_transfer_ep_callback,
        .ep_addr = DAP_USB_EP_OUT
    },
    [DAP_USB_EP_IN_IDX] = {
        .ep_cb = usb_transfer_ep_callback,
        .ep_addr = DAP_USB_EP_IN
    }
};

static void dapusb_read_cb(uint8_t ep, int size, void *priv);

static void dapusb_start_read(struct usb_cfg_data *cfg)
{
    usb_transfer(cfg->endpoint[DAP_USB_EP_OUT_IDX].ep_addr, rx_buf, sizeof(rx_buf),
                 USB_TRANS_READ, dapusb_read_cb, cfg);
}

static void dapusb_read_cb(uint8_t ep, int size, void *priv)
{
    struct usb_cfg_data *cfg = priv;
    struct dap_request req;

    ARG_UNUSED(ep);

    if (size > 0) {
        if (rx_buf[0] == ID_DAP_TransferAbort) {
            /* Handled immediately, like DAPLink/CMSIS-DAP reference */
            DAP_TransferAbort = 1U;
        } else {
            req.len = MIN(size, DAP_PACKET_SIZE);
            memcpy(req.data, rx_buf, req.len);
            k_msgq_put(&dap_rx_queue, &req, K_NO_WAIT);
        }
    }

    /* Flow control: NAK the host until a request buffer is free */
    if (k_msgq_num_free_get(&dap_rx_queue) == 0) {
        atomic_set(&rx_stalled, 1);
        return;
    }

    dapusb_start_read(cfg);
}

static void dapusb_dev_status_cb(struct usb_cfg_data *cfg,
                                 enum usb_dc_status_code status,
                                 const uint8_t *param)
{
    ARG_UNUSED(param);

    switch (status) {
    case USB_DC_CONFIGURED:
        if (!usb_transfer_is_busy(cfg->endpoint[DAP_USB_EP_OUT_IDX].ep_addr)) {
            atomic_set(&rx_stalled, 0);
            dapusb_start_read(cfg);
        }
        break;
    case USB_DC_RESET:
    case USB_DC_DISCONNECTED:
        k_msgq_purge(&dap_rx_queue);
        break;
    default:
        break;
    }
}

static void dapusb_interface_config(struct usb_desc_header *head,
                                    uint8_t bInterfaceNumber)
{
    ARG_UNUSED(head);

    dapusb_desc.if0.bInterfaceNumber = bInterfaceNumber;
#if defined(CONFIG_USB_COMPOSITE_DEVICE)
    msosv2_cmsis_dap_desc.subset_header.bFirstInterface = bInterfaceNumber;
#endif
}

USBD_DEFINE_CFG_DATA(dapusb_config) = {
    .usb_device_description = NULL,
    .interface_config = dapusb_interface_config,
    .interface_descriptor = &dapusb_desc.if0,
    .cb_usb_status = dapusb_dev_status_cb,
    .interface = {
        .class_handler = NULL,
        .custom_handler = NULL,
        .vendor_handler = msosv2_vendor_handle_req,
    },
    .num_endpoints = ARRAY_SIZE(dapusb_ep_data),
    .endpoint = dapusb_ep_data
};

int dap_usb_init(void)
{
    /* Add MS OS 2.0 BOS descriptor to BOS structure */
    usb_bos_register_cap((void *)&bos_cap_msosv2);
    /* Point interface index to string descriptor */
    dapusb_desc.if0.iInterface = usb_get_str_descriptor_idx(&dap_iface_desc);

    return 0;
}

int dap_usb_process(void)
{
    uint8_t ep = dapusb_config.endpoint[DAP_USB_EP_IN_IDX].ep_addr;
    struct dap_request req;
    uint32_t len;
    int ret;

    k_msgq_get(&dap_rx_queue, &req, K_FOREVER);

    if (atomic_cas(&rx_stalled, 1, 0)) {
        dapusb_start_read(&dapusb_config);
    }

    /* Commands shorter than declared read zeros instead of stale data */
    if (req.len < DAP_PACKET_SIZE) {
        memset(&req.data[req.len], 0, DAP_PACKET_SIZE - req.len);
    }

    len = DAP_ExecuteCommand(req.data, tx_buf) & 0xFFFFU;
    led_flash(LED_DAP);

    ret = usb_transfer_sync(ep, tx_buf, len, USB_TRANS_WRITE | USB_TRANS_NO_ZLP);
    if (ret < 0 || (uint32_t)ret != len) {
        return -EIO;
    }

    return 0;
}
```

## src/dap_usb.h
```c
/*
 * CMSIS-DAP v2 (WinUSB bulk) USB interface.
 *
 * SPDX-License-Identifier: Apache-2.0
 */

#ifndef DAP_USB_H
#define DAP_USB_H

int dap_usb_init(void);

/* Block for the next request, execute it and send the response */
int dap_usb_process(void);

#endif
```

## src/dap_vendor.c
```c
/*
 * CMSIS-DAP vendor commands.
 *
 * Subset of DAPLink source/daplink/cmsis-dap/DAP_vendor.c:
 *   ID_DAP_Vendor0   GetUniqueID (DAPLink)
 *   ID_DAP_Vendor31  Enter bootloader (Zephyr port: replaces the
 *                    START_BL.ACT file of the DAPLink MSC drive)
 *
 * SPDX-License-Identifier: Apache-2.0
 */

#include <string.h>

#include "DAP_config.h"
#include "DAP.h"
#include "info.h"
#include "bootloader.h"

#define ID_DAP_GetUniqueID              ID_DAP_Vendor0
#define ID_DAP_EnterBootloader          ID_DAP_Vendor31

uint32_t DAP_ProcessVendorCommand(const uint8_t *request, uint8_t *response)
{
    uint32_t num = (1U << 16) | 1U;

    *response++ = *request;        // copy Command ID

    switch (*request++) {          // first byte in request is Command ID
    case ID_DAP_GetUniqueID: {
        const char *id_str = info_get_unique_id();
        uint8_t len = strlen(id_str);
        *response++ = len;
        memcpy(response, id_str, len);
        num += (len + 1); // increment response count by ID length + length byte
        break;
    }
    case ID_DAP_EnterBootloader:
        bootloader_enter();
        break;
    default:
        *(response - 1) = ID_DAP_Invalid;
        break;
    }

    return (num);
}
```
