## CMakeLists.txt
```
# SPDX-License-Identifier: Apache-2.0

cmake_minimum_required(VERSION 3.20.0)

set(DAPLINK_IMAGE BL)
include(${CMAKE_CURRENT_SOURCE_DIR}/../common/daplink.cmake)

find_package(Zephyr REQUIRED HINTS $ENV{ZEPHYR_BASE})
project(daplink_bootloader)

daplink_setup()

# records/usb/usb-msc.yaml, records/daplink/drag-n-drop.yaml
zephyr_compile_definitions(MSC_ENDPOINT DRAG_N_DROP_SUPPORT)

# Zephyr glue first: overrides DAPLink IO_Config.h / device.h / cmsis_os2.h
zephyr_include_directories(
  ${CMAKE_CURRENT_SOURCE_DIR}/include
  ${CMAKE_CURRENT_SOURCE_DIR}/src
  ${DAPLINK_DIR}
  ${DAPLINK_DIR}/bootloader
  ${DAPLINK_DIR}/drag-n-drop
  ${DAPLINK_DIR}/settings
  ${DAPLINK_DIR}/target
  ${DAPLINK_DIR}/hic_hal
  ${DAPLINK_DIR}/usb
)

# DAPLink bootloader (records/daplink/bootloader.yaml, drag-n-drop.yaml,
# settings.yaml, settings_rom_stub.yaml, target_board.yaml), as-is
target_sources(app PRIVATE
  ${DAPLINK_DIR}/bootloader/daplink.c
  ${DAPLINK_DIR}/crc32.c
  ${DAPLINK_DIR}/error.c
  ${DAPLINK_DIR}/info.c
  ${DAPLINK_DIR}/util.c
  ${DAPLINK_DIR}/validation.c
  ${DAPLINK_DIR}/drag-n-drop/file_stream.c
  ${DAPLINK_DIR}/drag-n-drop/flash_decoder.c
  ${DAPLINK_DIR}/drag-n-drop/flash_intf.c
  ${DAPLINK_DIR}/drag-n-drop/flash_manager.c
  ${DAPLINK_DIR}/drag-n-drop/iap_flash_intf.c
  ${DAPLINK_DIR}/drag-n-drop/intelhex.c
  ${DAPLINK_DIR}/drag-n-drop/vfs_manager.c
  ${DAPLINK_DIR}/drag-n-drop/vfs_user.c
  ${DAPLINK_DIR}/drag-n-drop/virtual_fs.c
  ${DAPLINK_DIR}/settings/settings.c
  ${DAPLINK_DIR}/settings/settings_rom_stub.c
  ${DAPLINK_DIR}/target/target_board.c
  ${DAPLINK_DIR}/usb/usbd_msc.c
)

set_source_files_properties(
  ${DAPLINK_DIR}/bootloader/daplink.c
  PROPERTIES COMPILE_OPTIONS -Wno-unused-variable)

# Zephyr port
target_sources(app PRIVATE
  src/main_bootloader.c
  src/board.c
  src/cmsis_os2.c
  src/flash.c
  src/gpio.c
  src/read_uid.c
  src/usbd_msc_zephyr.c
)
zephyr_include_directories(${ZEPHYR_BASE}/subsys/usb/device)
```

## Kconfig
```
# SPDX-License-Identifier: Apache-2.0

mainmenu "DAPLink Zephyr bootloader"

source "Kconfig.zephyr"
```

## prj.conf
```kconfig
# DAPLink bootloader @ 0x08000000 (bl_partition), MAINTENANCE drive

# Image placement
CONFIG_USE_DT_CODE_PARTITION=y
CONFIG_FLASH=y
CONFIG_HWINFO=y
CONFIG_GPIO=y
CONFIG_REBOOT=y
CONFIG_POLL=y

# USB device stack (legacy, same as app) + DAPLink MSC class
CONFIG_USB_DEVICE_STACK=y
CONFIG_USB_DEVICE_VID=0x0D28
CONFIG_USB_DEVICE_PID=0x0204
CONFIG_USB_DEVICE_MANUFACTURER="ARM"
CONFIG_USB_DEVICE_PRODUCT="DAPLink CMSIS-DAP"
# 96 bit STM32 UID as hex
CONFIG_USB_DEVICE_SN="000000000000000000000000"
CONFIG_USB_MAX_POWER=50
CONFIG_USB_DEVICE_INITIALIZE_AT_BOOT=n
CONFIG_USB_WORKQUEUE=n

# Kernel (20 KB RAM, 256 B reserved for cfgram)
CONFIG_MAIN_STACK_SIZE=1536
CONFIG_ISR_STACK_SIZE=1024
CONFIG_SYSTEM_WORKQUEUE_STACK_SIZE=512
CONFIG_IDLE_STACK_SIZE=256

# Console/log is disabled: USART1 pins are used by LED / SWO
CONFIG_CONSOLE=n
CONFIG_UART_CONSOLE=n
CONFIG_SERIAL=n
CONFIG_LOG=n
CONFIG_PRINTK=n
CONFIG_BOOT_BANNER=n

# Size: bootloader region is 47 KB (DAPLINK_ROM_BL_SIZE)
CONFIG_SIZE_OPTIMIZATIONS=y
CONFIG_LTO=y
CONFIG_ISR_TABLES_LOCAL_DECLARATION=y
CONFIG_TIMESLICING=n
CONFIG_ERRNO=n
CONFIG_CBPRINTF_NANO=y
CONFIG_THREAD_MONITOR=n
CONFIG_HW_STACK_PROTECTION=n
CONFIG_ARM_MPU=n
CONFIG_ASSERT=n
```

## app.overlay
```dts
/* Bootloader @ 0x08000000 */
/ {
	chosen {
		zephyr,code-partition = &bl_partition;
	};
};
```

## include/IO_Config.h
```c
/*
 * DAPLink IO configuration for the Zephyr bootloader.
 *
 * Pins come from the devicetree (common/boards overlay), see src/gpio.c.
 *
 * SPDX-License-Identifier: Apache-2.0
 */

#ifndef __IO_CONFIG_H__
#define __IO_CONFIG_H__

#include <soc.h>
#include "daplink.h"

COMPILER_ASSERT(DAPLINK_HIC_ID == DAPLINK_HIC_ID_STM32F103XB);

#endif
```

## include/cmsis_os2.h
```c
/*
 * Minimal CMSIS-RTOS2 API on top of the Zephyr kernel.
 *
 * Only what DAPLink drag-n-drop (vfs_manager.c, file_stream.c) needs:
 * thread id and a mutex.
 *
 * SPDX-License-Identifier: Apache-2.0
 */

#ifndef CMSIS_OS2_H_
#define CMSIS_OS2_H_

#include <stdint.h>
#include <zephyr/kernel.h>

typedef k_tid_t osThreadId_t;
typedef struct k_mutex *osMutexId_t;
typedef int32_t osStatus_t;

#define osOK            0
#define osError         (-1)
#define osWaitForever   0xFFFFFFFFU

static inline osThreadId_t osThreadGetId(void)
{
    return k_current_get();
}

osMutexId_t osMutexNew(const void *attr);

static inline osStatus_t osMutexAcquire(osMutexId_t mutex_id, uint32_t timeout)
{
    k_timeout_t t = (timeout == osWaitForever) ? K_FOREVER : K_TICKS(timeout);

    return k_mutex_lock(mutex_id, t) ? osError : osOK;
}

static inline osStatus_t osMutexRelease(osMutexId_t mutex_id)
{
    return k_mutex_unlock(mutex_id) ? osError : osOK;
}

#endif
```

## include/device.h
```c
/*
 * DAPLink hic_hal/device.h for the Zephyr port: CMSIS device header.
 *
 * SPDX-License-Identifier: Apache-2.0
 */

#ifndef DAPLINK_DEVICE_H
#define DAPLINK_DEVICE_H

#include <soc.h>

#endif
```

## include/rl_usb.h
```c
/*
 * Minimal DAPLink RL-USB API for the Zephyr bootloader.
 *
 * Provides what usb/msc/usbd_msc.c (DAPLink MSC class) and
 * drag-n-drop/vfs_manager.c need, on top of the Zephyr legacy USB
 * device stack (src/usbd_msc_zephyr.c).
 *
 * SPDX-License-Identifier: Apache-2.0
 */

#ifndef RL_USB_H
#define RL_USB_H

#include <stdint.h>
#include "compiler.h"

typedef uint8_t  BOOL;
typedef uint8_t  U8;
typedef uint16_t U16;
typedef uint32_t U32;

#ifndef __TRUE
#define __TRUE  1
#endif
#ifndef __FALSE
#define __FALSE 0
#endif

#include "usb_msc.h"

/* USB Device events (usbd_event.h) */
#define USBD_EVT_OUT            (1 << 1)
#define USBD_EVT_IN             (1 << 2)

/* Setup packet, only wIndexL is used by the MSC class */
typedef struct {
    U8 wIndexL;
} USB_SETUP_PACKET;

extern USB_SETUP_PACKET USBD_SetupPacket;
extern U8   USBD_EP0Buf[];
extern U32  USBD_EndPointHalt;
extern U32  USBD_EndPointStall;
extern U8   USBD_HighSpeed;

/* MSC configuration (usb_lib.c) */
extern const U8  usbd_msc_ep_bulkin;
extern const U8  usbd_msc_ep_bulkout;
extern const U16 usbd_msc_maxpacketsize[2];
extern const U8 *usbd_msc_inquiry_data;
extern const U16 USBD_MSC_BulkBufSize;
extern U8   USBD_MSC_BulkBuf[];

/* MSC class state (usbd_msc.c) */
extern BOOL USBD_MSC_MediaReady;
extern BOOL USBD_MSC_ReadOnly;
extern U32  USBD_MSC_MemorySize;
extern U32  USBD_MSC_BlockSize;
extern U32  USBD_MSC_BlockGroup;
extern U32  USBD_MSC_BlockCount;
extern U8  *USBD_MSC_BlockBuf;
extern MSC_CSW USBD_MSC_CSW;

/* Hardware layer (usbd_hw.h) */
U32  USBD_ReadEP(U32 EPNum, U8 *pData, U32 size);
U32  USBD_WriteEP(U32 EPNum, U8 *pData, U32 cnt);
void USBD_SetStallEP(U32 EPNum);
void USBD_ClrStallEP(U32 EPNum);

/* MSC class (usbd_msc.h) */
void usbd_msc_init(void);
void usbd_msc_read_sect(U32 block, U8 *buf, U32 num_of_blocks);
void usbd_msc_write_sect(U32 block, U8 *buf, U32 num_of_blocks);
void usbd_msc_start_stop(BOOL start);

BOOL USBD_MSC_Reset(void);
BOOL USBD_MSC_GetMaxLUN(void);
void USBD_MSC_SetCSW(void);
void USBD_MSC_ClrStallEP(U32 EPNum);
void USBD_MSC_Reset_Event(void);
void USBD_MSC_EP_BULK_Event(U32 event);

#endif
```

## include/usb_for_lib.h
```c
/*
 * DAPLink usb_for_lib.h for the Zephyr bootloader: everything comes from
 * rl_usb.h.
 *
 * SPDX-License-Identifier: Apache-2.0
 */

#ifndef __USB_FOR_LIB_H__
#define __USB_FOR_LIB_H__

#include "rl_usb.h"

#endif
```

## src/board.c
```c
/*
 * Bootloader board / target info.
 *
 * Copied from DAPLink source/board/stm32f103xb_bl.c: the "target" of the
 * bootloader is the interface region of the HIC itself.
 *
 * DAPLink Interface Firmware
 * Copyright (c) 2009-2016, ARM Limited, All Rights Reserved
 * SPDX-License-Identifier: Apache-2.0
 */

#include "target_config.h"
#include "target_board.h"
#include "target_family.h"
#include "daplink_addr.h"

/**
* List of start and size for each size of flash sector
* The size will apply to all sectors between the listed address and the next address
* in the list.
* The last pair in the list will have sectors starting at that address and ending
* at address start + size.
*/
static const sector_info_t sectors_info[] = {
    {DAPLINK_ROM_IF_START, DAPLINK_SECTOR_SIZE},
 };

// stm32f103 target information
target_cfg_t target_device = {
    .version                    = kTargetConfigVersion,
    .sectors_info               = sectors_info,
    .sector_info_length         = (sizeof(sectors_info))/(sizeof(sector_info_t)),
    .flash_regions[0].start     = DAPLINK_ROM_IF_START,
    .flash_regions[0].end       = DAPLINK_ROM_IF_START + DAPLINK_ROM_IF_SIZE,
    .flash_regions[0].flags     = kRegionIsDefault,
    .ram_regions[0].start       = DAPLINK_RAM_START,
    .ram_regions[0].end         = DAPLINK_RAM_START + DAPLINK_RAM_SIZE,
    /* .flash_algo not needed for bootloader */
};

//bootloader has no family
const target_family_descriptor_t *g_target_family = NULL;

const board_info_t g_board_info = {
    .info_version = kBoardInfoVersion,
    .board_id = "0000",
    .daplink_url_name =       "HELP_FAQHTM",
    .daplink_drive_name = 		"MAINTENANCE",
    .daplink_target_url = "https://daplink.io",
    .target_cfg = &target_device,
};
```

## src/cmsis_os2.c
```c
/*
 * Minimal CMSIS-RTOS2 API on top of the Zephyr kernel.
 *
 * SPDX-License-Identifier: Apache-2.0
 */

#include "cmsis_os2.h"

/* vfs_manager.c creates a single mutex */
static struct k_mutex os_mutex_pool[1];
static uint32_t os_mutex_count;

osMutexId_t osMutexNew(const void *attr)
{
    struct k_mutex *mutex;

    ARG_UNUSED(attr);

    if (os_mutex_count >= ARRAY_SIZE(os_mutex_pool)) {
        return NULL;
    }
    mutex = &os_mutex_pool[os_mutex_count++];
    k_mutex_init(mutex);

    return mutex;
}
```

## src/flash.c
```c
/*
 * HIC internal flash programming (DAPLink FlashPrg.h / flash_hal.h).
 *
 * Replaces hic_hal/stm32/stm32f103xb/flash.c and daplink/flash_hal.c,
 * using the Zephyr flash driver.
 *
 * SPDX-License-Identifier: Apache-2.0
 */

#include <zephyr/kernel.h>
#include <zephyr/drivers/flash.h>

#include "flash_hal.h"
#include "daplink_addr.h"
#include "compiler.h"

static const struct device *const flash_dev = DEVICE_DT_GET(DT_CHOSEN(zephyr_flash_controller));

uint32_t Init(uint32_t adr, uint32_t clk, uint32_t fnc)
{
    return device_is_ready(flash_dev) ? 0 : 1;
}

uint32_t UnInit(uint32_t fnc)
{
    return (0);
}

uint32_t EraseChip(void)
{
    /* Not used: iap_flash_intf erases the update region sector by sector */
    return (1);
}

uint32_t EraseSector(uint32_t adr)
{
    return flash_erase(flash_dev, adr - DAPLINK_ROM_START, DAPLINK_SECTOR_SIZE) ? 1 : 0;
}

uint32_t ProgramPage(uint32_t adr, uint32_t sz, uint32_t *buf)
{
    return flash_write(flash_dev, adr - DAPLINK_ROM_START, buf, sz) ? 1 : 0;
}

uint32_t flash_erase_sector(uint32_t addr)
{
    return EraseSector(addr);
}

uint32_t flash_program_page(uint32_t adr, uint32_t sz, uint8_t *buf)
{
    return ProgramPage(adr, sz, (uint32_t *)buf);
}

bool flash_is_readable(uint32_t addr, uint32_t length)
{
    uint32_t end_addr = addr + length - 1;
    return (addr >= DAPLINK_ROM_START && addr < (DAPLINK_ROM_START + DAPLINK_ROM_SIZE))
        && (end_addr >= DAPLINK_ROM_START && end_addr < (DAPLINK_ROM_START + DAPLINK_ROM_SIZE));
}
```

## src/gpio.c
```c
/*
 * Bootloader GPIO: MSC LED and reset button (DAPLink hic_hal gpio.h).
 *
 * Ported from hic_hal/stm32/stm32f103xb/gpio.c. The target nRESET line
 * (TGT_RST, with the RST1 button) is the "hold in bootloader" button.
 *
 * SPDX-License-Identifier: Apache-2.0
 */

#include <zephyr/kernel.h>
#include <zephyr/drivers/gpio.h>

#include "gpio.h"

static const struct gpio_dt_spec msc_led = GPIO_DT_SPEC_GET(DT_NODELABEL(led_msc), gpios);
static const struct gpio_dt_spec reset_btn =
    GPIO_DT_SPEC_GET(DT_PATH(zephyr_user), nreset_gpios);

void gpio_init(void)
{
    gpio_pin_configure_dt(&msc_led, GPIO_OUTPUT_INACTIVE);
    /* reset button configured as input with a pullup */
    gpio_pin_configure_dt(&reset_btn, GPIO_INPUT | GPIO_PULL_UP);

    // Let the voltage rails stabilize.  This is especailly important
    // during software resets, since the target's 3.3v rail can take
    // 20-50ms to drain.  During this time the target could be driving
    // the reset pin low, causing the bootloader to think the reset
    // button is pressed.
    k_busy_wait(85 * USEC_PER_MSEC);
}

void gpio_set_board_power(bool powerEnabled)
{
}

void gpio_set_hid_led(gpio_led_state_t state)
{
}

void gpio_set_cdc_led(gpio_led_state_t state)
{
}

void gpio_set_msc_led(gpio_led_state_t state)
{
    gpio_pin_set_dt(&msc_led, state == GPIO_LED_ON);
}

uint8_t gpio_get_reset_btn_no_fwrd(void)
{
    /* Raw level: low = pressed */
    return gpio_pin_get_raw(reset_btn.port, reset_btn.pin) ? 0 : 1;
}

uint8_t gpio_get_reset_btn_fwrd(void)
{
    return 0;
}
```

## src/main_bootloader.c
```c
/*
 * DAPLink bootloader, Zephyr port.
 *
 * Ported from DAPLink source/daplink/bootloader/main_bootloader.c:
 *   - jump to the interface (0x0800C000) when it is valid and the reset
 *     button is not pressed and the interface did not request
 *     "hold in bootloader"
 *   - otherwise expose the MAINTENANCE drive (DAPLink drag-n-drop vfs)
 *     over USB MSC to update the interface
 *
 * DAPLink Interface Firmware
 * Copyright (c) 2009-2016, ARM Limited, All Rights Reserved
 * SPDX-License-Identifier: Apache-2.0
 */

#include <zephyr/kernel.h>
#include <zephyr/sys/reboot.h>
#include <cmsis_core.h>

#include "main_bootloader.h"
#include "gpio.h"
#include "validation.h"
#include "vfs_manager.h"
#include "rl_usb.h"
#include "settings.h"
#include "info.h"
#include "target_config.h"
#include "util.h"
#include "cortex_m.h"
#include "target_board.h"
#include "usbd_msc_zephyr.h"

//default msc led settings
#ifndef MSC_LED_DEF
#define MSC_LED_DEF GPIO_LED_ON
#endif

// Event flags for main task
// Timers events
#define FLAGS_MAIN_90MS         (1 << 0)
#define FLAGS_MAIN_30MS         (1 << 1)

// Timing constants (in 90mS ticks)
// USB busy time
#define USB_BUSY_TIME           (33)
// Delay before a USB device connect may occur
#define USB_CONNECT_DELAY       (11)
// Decrement to zero
#define DECZERO(x)              (x ? --x : 0)

// Global state of usb used in
main_usb_connect_t usb_state;

static uint8_t msc_led_usb_activity = 0;
static main_led_state_t msc_led_state = MAIN_LED_FLASH;

static main_usb_busy_t usb_busy;
static uint32_t usb_busy_count;

static struct k_poll_signal timer_signal = K_POLL_SIGNAL_INITIALIZER(timer_signal);
static struct k_poll_signal usb_signal = K_POLL_SIGNAL_INITIALIZER(usb_signal);
static atomic_t timer_flags;

void SystemReset(void)
{
    sys_reboot(SYS_REBOOT_COLD);
}

static void modify_stack_pointer_and_start_app(uint32_t r0_sp, uint32_t r1_pc)
{
    uint32_t z = 0;
    __ASM volatile (  "msr    control, %[z]   \n\t"
                      "isb                    \n\t"
                      "mov    sp, %[r0_sp]    \n\t"
                      "bx     %[r1_pc]"
                      :
                      :   [z] "l" (z),
                          [r0_sp] "l" (r0_sp),
                          [r1_pc] "l" (r1_pc)
                  );
}

__weak bool reset_button_pressed(void)
{
    return gpio_get_reset_btn();
}

__weak void board_bootloader_init(void)
{
    return;
}

// Timer task, set flags every 30mS and 90mS
static void timer_task_30mS(struct k_timer *timer)
{
    static uint32_t i = 0;
    uint32_t flags = FLAGS_MAIN_30MS;

    ARG_UNUSED(timer);

    if (!(i++ % 3)) {
        flags |= FLAGS_MAIN_90MS;
    }
    atomic_or(&timer_flags, flags);
    k_poll_signal_raise(&timer_signal, 0);
}

static K_TIMER_DEFINE(main_timer, timer_task_30mS, NULL);

// Flash MSC LED using 30mS tick
void main_blink_msc_led(main_led_state_t state)
{
    msc_led_usb_activity = 1;
    msc_led_state = state;
    usb_busy = MAIN_USB_ACTIVE;
    usb_busy_count = USB_BUSY_TIME;
    return;
}

static void main_task(void)
{
    // State processing
    uint32_t flags;
    // LED
    gpio_led_state_t msc_led_value = MSC_LED_DEF;
    // USB
    uint32_t usb_state_count;
    struct k_poll_event events[] = {
        K_POLL_EVENT_INITIALIZER(K_POLL_TYPE_SIGNAL, K_POLL_MODE_NOTIFY_ONLY, &timer_signal),
        K_POLL_EVENT_INITIALIZER(K_POLL_TYPE_SIGNAL, K_POLL_MODE_NOTIFY_ONLY, &usb_signal),
    };

    if (config_ram_get_initial_hold_in_bl()) {
        // Delay for 1 second for VMs
        k_msleep(100);
    }

    // Set LED defaults
    gpio_set_hid_led(GPIO_LED_OFF);
    gpio_set_cdc_led(GPIO_LED_OFF);
    gpio_set_msc_led(msc_led_value);
    // Update version information file
    info_init();
    // USB
    usbd_msc_zephyr_init(&usb_signal);
    usbd_msc_init();
    vfs_mngr_init(true);
    usbd_connect(0);
    usb_busy = MAIN_USB_IDLE;
    usb_busy_count = 0;
    usb_state = MAIN_USB_CONNECTING;
    usb_state_count = USB_CONNECT_DELAY;
    // Start timer tasks
    k_timer_start(&main_timer, K_MSEC(30), K_MSEC(30));

    while (1) {
        k_poll(events, ARRAY_SIZE(events), K_FOREVER);

        if (events[1].state == K_POLL_STATE_SIGNALED) {
            events[1].signal->signaled = 0;
            events[1].state = K_POLL_STATE_NOT_READY;
            // process usb events
            usbd_msc_process();
        }

        if (events[0].state != K_POLL_STATE_SIGNALED) {
            continue;
        }
        events[0].signal->signaled = 0;
        events[0].state = K_POLL_STATE_NOT_READY;
        flags = atomic_clear(&timer_flags);

        if (flags & FLAGS_MAIN_90MS) {
            vfs_mngr_periodic(90); // FLAGS_MAIN_90MS

            // Update USB busy status
            switch (usb_busy) {
                case MAIN_USB_ACTIVE:
                    if (DECZERO(usb_busy_count) == 0) {
                        usb_busy = MAIN_USB_IDLE;
                    }

                    break;

                case MAIN_USB_IDLE:
                default:
                    break;
            }

            // Update USB connect status
            switch (usb_state) {
                case MAIN_USB_DISCONNECTING:

                    // Wait until USB is idle before disconnecting
                    if (usb_busy == MAIN_USB_IDLE && (DECZERO(usb_state_count) == 0)) {
                        usbd_connect(0);
                        usb_state = MAIN_USB_DISCONNECTED;
                    }

                    break;

                case MAIN_USB_CONNECTING:

                    // Wait before connecting
                    if (DECZERO(usb_state_count) == 0) {
                        usbd_connect(1);
                        usb_state = MAIN_USB_CHECK_CONNECTED;
                    }

                    break;

                case MAIN_USB_CHECK_CONNECTED:
                    if (usbd_configured()) {
                        usb_state = MAIN_USB_CONNECTED;
                    }

                    break;

                case MAIN_USB_DISCONNECTED:
                    SystemReset();
                    break;

                case MAIN_USB_CONNECTED:
                default:
                    break;
            }
        }

        // 30mS tick used for flashing LED when USB is busy
        if (flags & FLAGS_MAIN_30MS) {
            if (msc_led_usb_activity) {

                if ((msc_led_state == MAIN_LED_FLASH) || (msc_led_state == MAIN_LED_FLASH_PERMANENT)) {
                    // Toggle LED value
                    msc_led_value = (GPIO_LED_ON == msc_led_value) ? GPIO_LED_OFF : GPIO_LED_ON;
                    // If in flash mode stop after one cycle but in bootloader LED stays on
                    if ((MSC_LED_DEF == msc_led_value) && (MAIN_LED_FLASH == msc_led_state)) {
                        msc_led_usb_activity = 0;
                        msc_led_state = MAIN_LED_DEF;
                    }

                }else{
                    //LED next state is MAIN_LED_DEF
                    msc_led_value = MSC_LED_DEF;
                    msc_led_usb_activity = 0;
                }

                // Update hardware
                gpio_set_msc_led(msc_led_value);
            }
        }
    }
}

int main(void)
{
    // init leds and button
    gpio_init();
    // init settings
    config_init();
    // Hook for custom boards initialisation
    board_bootloader_init();

    // check for invalid app image or rst button press. Should be checksum or CRC but NVIC validation is better than nothing.
    // If the interface has set the hold in bootloader setting don't jump to app
    if (!reset_button_pressed()
            && g_board_info.target_cfg
            && validate_bin_nvic((uint8_t *)g_board_info.target_cfg->flash_regions[0].start)
            && !config_ram_get_initial_hold_in_bl()) {
        uint32_t app = g_board_info.target_cfg->flash_regions[0].start;

        // Stop the kernel tick and all interrupts used by the bootloader
        __disable_irq();
        SysTick->CTRL = 0;
        for (int i = 0; i < ARRAY_SIZE(NVIC->ICER); i++) {
            NVIC->ICER[i] = 0xFFFFFFFF;
            NVIC->ICPR[i] = 0xFFFFFFFF;
        }
        // change to the new vector table
        SCB->VTOR = app; //bootloaders should only have one flash region for interface
        // Zephyr masks interrupts with BASEPRI, start the app unmasked like DAPLink
        __set_BASEPRI(0);
        __enable_irq();
        // modify stack pointer and start app
        modify_stack_pointer_and_start_app((*(uint32_t *)(app)),
                (*(uint32_t *)(app + 4)));
    }

    // either the rst pin was pressed or we have an empty app region
    main_task();

    return 0;
}
```

## src/read_uid.c
```c
/*
 * HIC unique ID (DAPLink hic_hal read_uid.h).
 *
 * SPDX-License-Identifier: Apache-2.0
 */

#include <string.h>
#include <zephyr/drivers/hwinfo.h>

#include "read_uid.h"

void read_unique_id(uint32_t *id)
{
    uint32_t uid[3] = {0};

    /* STM32F1: 96 bit UID at 0x1FFFF7E8 */
    hwinfo_get_device_id((uint8_t *)uid, sizeof(uid));

    id[0] = uid[0];
    id[1] = uid[1];
    id[2] = uid[2];
    id[3] = 0xA5A5A5A5;
}
```

## src/usbd_msc_zephyr.c
```c
/*
 * DAPLink MSC class (usb/msc/usbd_msc.c) on the Zephyr legacy USB stack.
 *
 * Replaces the DAPLink RL-USB core (usbd_core.c, usb_lib.c, usbd_core_msc.c
 * and hic_hal usbd_STM32F103.c):
 *   - interface / endpoint descriptors
 *   - MSC class requests (Bulk-Only Reset, Get Max LUN)
 *   - CLEAR_FEATURE(ENDPOINT_HALT) handling (USBD_ReqSetClrFeature)
 *   - USBD_ReadEP / USBD_WriteEP / USBD_SetStallEP / USBD_ClrStallEP
 *
 * Endpoint events are only flagged from the USB ISR and processed by the
 * main task with usbd_msc_process(), like DAPLink USBD_SignalHandler() ->
 * USBD_Handler(), so all vfs_manager calls run in a single thread.
 *
 * SPDX-License-Identifier: Apache-2.0
 */

#include <zephyr/kernel.h>
#include <zephyr/sys/byteorder.h>
#include <zephyr/sys/atomic.h>
#include <zephyr/usb/usb_device.h>
#include <usb_descriptor.h>

#include "rl_usb.h"
#include "usbd_msc_zephyr.h"

#define MSC_EP_OUT          0x01
#define MSC_EP_IN           0x82
#define MSC_EP_OUT_IDX      0
#define MSC_EP_IN_IDX       1
#define MSC_EP_MPS          64

/* usb_lib.c MSC configuration */
const U8  usbd_msc_ep_bulkin = MSC_EP_IN & 0x0F;
const U8  usbd_msc_ep_bulkout = MSC_EP_OUT;
const U16 usbd_msc_maxpacketsize[2] = {MSC_EP_MPS, MSC_EP_MPS};
/* Vendor (8), Product (16), Revision (4), like USBD_MSC_INQUIRY_DATA */
const U8 *usbd_msc_inquiry_data = (const U8 *)"MBED    " "VFS             " "0.1 ";
const U16 USBD_MSC_BulkBufSize = MSC_EP_MPS;
U8 USBD_MSC_BulkBuf[MSC_EP_MPS];

/* usbd_core.c state used by the MSC class */
USB_SETUP_PACKET USBD_SetupPacket;
U8   USBD_EP0Buf[8];
U32  USBD_EndPointHalt;
U32  USBD_EndPointStall;
U8   USBD_HighSpeed;

static atomic_t ep_events;
static struct k_poll_signal *usb_signal;
static volatile bool usb_configured;

USBD_CLASS_DESCR_DEFINE(primary, 0) struct {
    struct usb_if_descriptor if0;
    struct usb_ep_descriptor if0_in_ep;
    struct usb_ep_descriptor if0_out_ep;
} __packed msc_desc = {
    .if0 = {
        .bLength = sizeof(struct usb_if_descriptor),
        .bDescriptorType = USB_DESC_INTERFACE,
        .bInterfaceNumber = 0,
        .bAlternateSetting = 0,
        .bNumEndpoints = 2,
        .bInterfaceClass = USB_BCC_MASS_STORAGE,
        .bInterfaceSubClass = MSC_SUBCLASS_SCSI,
        .bInterfaceProtocol = MSC_PROTOCOL_BULK_ONLY,
        .iInterface = 0,
    },
    .if0_in_ep = {
        .bLength = sizeof(struct usb_ep_descriptor),
        .bDescriptorType = USB_DESC_ENDPOINT,
        .bEndpointAddress = MSC_EP_IN,
        .bmAttributes = USB_DC_EP_BULK,
        .wMaxPacketSize = sys_cpu_to_le16(MSC_EP_MPS),
        .bInterval = 0,
    },
    .if0_out_ep = {
        .bLength = sizeof(struct usb_ep_descriptor),
        .bDescriptorType = USB_DESC_ENDPOINT,
        .bEndpointAddress = MSC_EP_OUT,
        .bmAttributes = USB_DC_EP_BULK,
        .wMaxPacketSize = sys_cpu_to_le16(MSC_EP_MPS),
        .bInterval = 0,
    },
};

static void msc_signal(uint32_t event)
{
    atomic_or(&ep_events, event);
    k_poll_signal_raise(usb_signal, 0);
}

static void msc_ep_cb(uint8_t ep, enum usb_dc_ep_cb_status_code status)
{
    if (status == USB_DC_EP_DATA_OUT) {
        msc_signal(USBD_EVT_OUT);
    } else if (status == USB_DC_EP_DATA_IN) {
        msc_signal(USBD_EVT_IN);
    }
}

static struct usb_ep_cfg_data msc_ep_data[] = {
    [MSC_EP_OUT_IDX] = {
        .ep_cb = msc_ep_cb,
        .ep_addr = MSC_EP_OUT
    },
    [MSC_EP_IN_IDX] = {
        .ep_cb = msc_ep_cb,
        .ep_addr = MSC_EP_IN
    }
};

static int msc_class_handler(struct usb_setup_packet *setup,
                             int32_t *len, uint8_t **data)
{
    /* usbd_core_msc.c USBD_EndPoint0_Setup_MSC_ReqToIF() */
    if (setup->wIndex != msc_desc.if0.bInterfaceNumber) {
        return -ENOTSUP;
    }

    switch (setup->bRequest) {
    case MSC_REQUEST_RESET:
        if (setup->wValue == 0 && setup->wLength == 0 && USBD_MSC_Reset()) {
            *len = 0;
            return 0;
        }
        break;
    case MSC_REQUEST_GET_MAX_LUN:
        if (setup->wValue == 0 && setup->wLength == 1 && USBD_MSC_GetMaxLUN()) {
            *data = USBD_EP0Buf;
            *len = 1;
            return 0;
        }
        break;
    }

    return -ENOTSUP;
}

static int msc_custom_handler(struct usb_setup_packet *setup,
                              int32_t *len, uint8_t **data)
{
    uint32_t n, m;

    /* usbd_core.c USBD_ReqSetClrFeature(): endpoint CLEAR_FEATURE(HALT) */
    if (setup->RequestType.recipient != USB_REQTYPE_RECIPIENT_ENDPOINT ||
        setup->bRequest != USB_SREQ_CLEAR_FEATURE ||
        setup->wValue != USB_SFS_ENDPOINT_HALT) {
        return -EINVAL;
    }

    n = setup->wIndex & 0x8F;
    m = (n & 0x80) ? ((1 << 16) << (n & 0x0F)) : (1 << n);
    if ((n & 0x0F) == 0) {
        return -EINVAL;
    }

    if ((USBD_EndPointStall & m) != 0) {
        /* EP must stay stalled */
        *len = 0;
        return 0;
    }

    USBD_ClrStallEP(n);
    USBD_SetupPacket.wIndexL = (uint8_t)setup->wIndex;
    USBD_MSC_ClrStallEP(n);
    USBD_EndPointHalt &= ~m;
    *len = 0;

    return 0;
}

static void msc_status_cb(struct usb_cfg_data *cfg, enum usb_dc_status_code status,
                          const uint8_t *param)
{
    ARG_UNUSED(cfg);
    ARG_UNUSED(param);

    switch (status) {
    case USB_DC_RESET:
        usb_configured = false;
        USBD_EndPointHalt = 0;
        USBD_EndPointStall = 0;
        msc_signal(USBD_MSC_EVT_RESET);
        break;
    case USB_DC_CONFIGURED:
        usb_configured = true;
        break;
    case USB_DC_DISCONNECTED:
        usb_configured = false;
        break;
    default:
        break;
    }
}

static void msc_interface_config(struct usb_desc_header *head, uint8_t bInterfaceNumber)
{
    ARG_UNUSED(head);
    msc_desc.if0.bInterfaceNumber = bInterfaceNumber;
}

USBD_DEFINE_CFG_DATA(msc_config) = {
    .usb_device_description = NULL,
    .interface_config = msc_interface_config,
    .interface_descriptor = &msc_desc.if0,
    .cb_usb_status = msc_status_cb,
    .interface = {
        .class_handler = msc_class_handler,
        .custom_handler = msc_custom_handler,
    },
    .num_endpoints = ARRAY_SIZE(msc_ep_data),
    .endpoint = msc_ep_data,
};

/* usbd_hw.h -------------------------------------------------------------- */

static uint8_t ep_addr(U32 EPNum)
{
    return (EPNum & 0x80) ? (0x80 | (EPNum & 0x0F)) : (EPNum & 0x0F);
}

U32 USBD_ReadEP(U32 EPNum, U8 *pData, U32 size)
{
    uint32_t read = 0;

    usb_ep_read_wait(ep_addr(EPNum), pData, size, &read);
    usb_ep_read_continue(ep_addr(EPNum));

    return read;
}

U32 USBD_WriteEP(U32 EPNum, U8 *pData, U32 cnt)
{
    uint32_t written = 0;

    usb_write(ep_addr(EPNum), pData, cnt, &written);

    return written;
}

void USBD_SetStallEP(U32 EPNum)
{
    usb_ep_set_stall(ep_addr(EPNum));
}

void USBD_ClrStallEP(U32 EPNum)
{
    usb_ep_clear_stall(ep_addr(EPNum));
}

/* API -------------------------------------------------------------------- */

int usbd_msc_zephyr_init(struct k_poll_signal *signal)
{
    usb_signal = signal;
    return 0;
}

void usbd_msc_process(void)
{
    uint32_t events = atomic_clear(&ep_events);

    if (events & USBD_MSC_EVT_RESET) {
        USBD_MSC_Reset_Event();
    }
    if (events & (USBD_EVT_OUT | USBD_EVT_IN)) {
        USBD_MSC_EP_BULK_Event(events);
    }
}

bool usbd_configured(void)
{
    return usb_configured;
}

void usbd_connect(bool connect)
{
    if (connect) {
        usb_enable(NULL);
    } else {
        usb_disable();
        usb_configured = false;
    }
}
```
